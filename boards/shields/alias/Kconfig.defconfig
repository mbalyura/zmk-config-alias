## boards/shields/alias/Kconfig.defconfig
```kconfig
if SHIELD_ALIAS

config ZMK_KEYBOARD_NAME
    default "Alias"

config ZMK_USB
    default y

config ZMK_BLE
    default y

config ZMK_STUDIO
    default n

endif
```
